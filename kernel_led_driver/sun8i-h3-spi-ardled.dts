/dts-v1/;
/plugin/;

/ {
	compatible = "allwinner,sun8i-h3";

	fragment@0 {
		target = <&spi0>;
		__overlay__ {
			#address-cells = <1>;
			#size-cells = <0>;
            status = "okay";
			ardled {
				compatible = "arduino,ardled", "ardled";
				reg = <0>;
				spi-max-frequency = <1000000>;
                status = "okay";
			};
		};
	};
};